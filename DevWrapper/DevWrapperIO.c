/*!
================================================================================
@Project    : STM32_Standard_Wrapper_Libs  
@Module     : GPIO
--------------------------------------------------------------------------------
@File Name	: DevWrapperIO.c                                                                                           
@Copyright by su.ch                                                    
--------------------------------------------------------------------------------
Change Records                                                              
--------------------------------------------------------------------------------
	[No]       [Name]       [Date]      [Description]                         
   1         su.ch        2022/01/16   first                                  
================================================================================
*/

//!-----------------------------------------------------------------------------
//!------------------------------> For Debug <----------------------------------
//!-----------------------------------------------------------------------------

//!-----------------------------------------------------------------------------
//!------------------------------> Includes  <----------------------------------
//!-----------------------------------------------------------------------------
#include "DevWrapperIO.h"

//!-----------------------------------------------------------------------------
//!---------------------------> Local Defines   <-------------------------------
//!-----------------------------------------------------------------------------

//!-----------------------------------------------------------------------------
//!---------------------------> Local Variables <-------------------------------
//!-----------------------------------------------------------------------------

//!-----------------------------------------------------------------------------
//!------------------------> External Variables <-------------------------------
//!-----------------------------------------------------------------------------

//!-----------------------------------------------------------------------------
//!------------------------> External Functions <-------------------------------
//!-----------------------------------------------------------------------------

//!-----------------------------------------------------------------------------
//!--------------------------> Function Section   <-----------------------------
//!-----------------------------------------------------------------------------

/*!
================================================================================
@Brief
  GPIO initialization.                                       
@Param
	ioPro [the structure pointer of GPIO]                                       
@Return	
	None.                                   
-------------------------------------------------------------------------------
*/
void InitIO(IOProfile *ioPro)
{
    //ASSERT(ioPro != NULL);
	
    if(ioPro->isUsed)
    {
        GPIO_InitTypeDef GPIO_InitStructure;
			
			  if((ioPro->GPIOx) == GPIOA)
				{
					  RCC_APB2PeriphClockCmd(RCC_APB2Periph_GPIOA, ENABLE);
				}
				else if((ioPro->GPIOx) == GPIOB)
				{
				    RCC_APB2PeriphClockCmd(RCC_APB2Periph_GPIOB, ENABLE);
				}
				else if((ioPro->GPIOx) == GPIOC)
				{
				    RCC_APB2PeriphClockCmd(RCC_APB2Periph_GPIOC, ENABLE);
				}
				else if((ioPro->GPIOx) == GPIOD)
				{
				    RCC_APB2PeriphClockCmd(RCC_APB2Periph_GPIOD, ENABLE);
				}
				else if((ioPro->GPIOx) == GPIOE)
				{
				    RCC_APB2PeriphClockCmd(RCC_APB2Periph_GPIOE, ENABLE);
				}
				else if((ioPro->GPIOx) == GPIOF)
				{
				    RCC_APB2PeriphClockCmd(RCC_APB2Periph_GPIOF, ENABLE);
				}
				else if((ioPro->GPIOx) == GPIOG)
				{
				    RCC_APB2PeriphClockCmd(RCC_APB2Periph_GPIOG, ENABLE);
				}
				else
				{
				    //ASSERT(0);
				}
				
				GPIO_InitStructure.GPIO_Mode = ioPro->GPIO_Mode;
				GPIO_InitStructure.GPIO_Speed = GPIO_Speed_50MHz;
				GPIO_InitStructure.GPIO_Pin = ioPro->GPIO_Pin;
				GPIO_Init(ioPro->GPIOx, &GPIO_InitStructure);
    }
}
